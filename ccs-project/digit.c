#include <stdint.h>
#include "lcd.h"

#include "digit.h"

#if 1
// Präprozessor-Anweisung für Folding

// Ziffern 6x8 für Legende der RPM-Anzeige (siehe gfx/big8x6num.png)
static const uint8_t DIGIT_DATA_6x8[] = { 0x7e, 0xff, 0x81, 0x81, 0xff, 0x7e,
		0x84, 0x82, 0xff, 0xff, 0x80, 0x80, 0x82, 0xc1, 0xe1, 0xb1, 0x9f, 0x8e,
		0x42, 0x89, 0x89, 0x89, 0xff, 0x76, 0x30, 0x2c, 0x23, 0xff, 0xff, 0x20,
		0x4f, 0x8f, 0x89, 0x89, 0xf9, 0x71, 0x7c, 0xfe, 0x8b, 0x89, 0xf9, 0x70,
		0x1, 0xc1, 0xf1, 0x3d, 0xf, 0x3, 0x76, 0xff, 0x89, 0x89, 0xff, 0x76,
		0x8e, 0x9f, 0x91, 0xd1, 0x7f, 0x3e };

// Ziffern 20x32 für die Anzeige der Geschwindigkeit (siehe gfx/speedfont.png)
static const uint8_t DIGIT_DATA_20x32[] = { 0x0, 0xfe, 0xff, 0x0, 0xc0, 0xff,
		0xff, 0x3, 0xe0, 0xff, 0xff, 0xf, 0xf0, 0xff, 0xff, 0x1f, 0xf8, 0xff,
		0xff, 0x3f, 0xf8, 0xff, 0xff, 0x3f, 0xfc, 0xff, 0xff, 0x7f, 0xfc, 0x0,
		0x0, 0x7e, 0x7c, 0x0, 0x0, 0x7c, 0x7c, 0x0, 0x0, 0x7c, 0x7c, 0x0, 0x0,
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		0x0, 0x0, 0x0 };
#endif

/**
 * Zeichnen einer 6x8 Ziffer
 *
 * @param x			X-Position
 * @param y_page	Y-Page
 * @param digit		Ziffer
 */
void digit_draw_6x8(uint8_t x, uint8_t y_page, uint8_t digit) {
	const uint8_t *pt = &(DIGIT_DATA_6x8[6 * digit]);

	for (uint8_t i = 0; i < 6; i++) {
		lcd_set_pixels(x + i, y_page, *pt);
		pt++;
	}
}

/**
 * Zeichnen einer 20x32 Ziffer
 *
 * @param x			X-Position
 * @param y_page	Y-Page
 * @param digit		Ziffer
 */
void digit_draw_20x32(uint8_t x, uint8_t y_page, uint8_t digit) {
	const uint8_t *pt = &(DIGIT_DATA_20x32[20 * 4 * digit]);

	for (uint8_t i = 0; i < 20; i++) {
		for (uint8_t y = 0; y < 4; y++) {
			lcd_set_pixels(x + i, y_page + y, *pt);
			pt++;
		}
	}
}

/**
 * Löschen des Bereiches einer 20x32 Ziffer
 *
 * @param x			X-Position
 * @param y_page	Y-Page
 */
void digit_clear_20x32(uint8_t x, uint8_t y_page) {
	for (uint8_t i = 0; i < 20; i++) {
		for (uint8_t y = 0; y < 4; y++) {
			lcd_set_pixels(x + i, y_page + y, 0);
		}
	}
}
