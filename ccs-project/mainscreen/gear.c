#include <msp430.h>
#include <stdint.h>
#include "lcd.h"
#include "digit.h"
#include "timer.h"

#include "gear.h"

static const uint8_t GEAR_DATA_DIGITS[] = { 0x0, 0x0, 0x0, 0x0, 0x0, 0x0, 0x0,
		0x0, 0x0, 0x0, 0x3c, 0x0, 0x0, 0x3c, 0x0, 0x0, 0x3c, 0x0, 0x0, 0x3c,
		0x0, 0x0, 0x3c, 0x0, 0x0, 0x3c, 0x0, 0x0, 0x3c, 0x0, 0x0, 0x3c, 0x0,
		0x0, 0x3c, 0x0, 0x0, 0x3c, 0x0, 0x0, 0x0, 0x0, 0x0, 0x0, 0x0, 0x0, 0x0,
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		0xc0, 0x3, 0x0, 0xc0, 0x3 }; //!< Pixeldaten der Ziffern der Gänge, siehe gfx/digits_gear.png

// Einstellung der Gänge
static const uint8_t GEAR_VALUE_HIGH[] = { 110, 55, 40 }; // Maximum des Parameters
static const uint8_t GEAR_VALUE_LOW[] = { 90, 45, 30 };	// Minimum des Parameters
static const uint8_t GEAR_COUNT = 3;						// Anzahl der Gänge

static const uint8_t GEAR_X = 85;	//!< Position der Anzeige
static const uint8_t GEAR_Y = 5;	//!< Y-Page

/**
 * Aktualisierung der Anzeige
 */
void gear_draw() {
	uint8_t gear = 0;
	uint8_t gear_value = gear_calculate_value();


	if (gear_value != 0) {
		// Auswählen des Ganges
		for (uint8_t i = 0; i < GEAR_COUNT; i++) {
			if (gear_value >= GEAR_VALUE_LOW[i]
					&& gear_value < GEAR_VALUE_HIGH[i]) {
				gear = i + 1;
				break;
			}
		}
	}

	// Zeichnen der Ganganzeige
	const uint8_t *pt = &(GEAR_DATA_DIGITS[16 * 3 * gear]);

	for (uint8_t i = 0; i < 16; i++) {
		for (uint8_t y = 0; y < 3; y++) {
			lcd_set_pixels(GEAR_X + i, GEAR_Y + y, *pt);
			pt++;
		}
	}
}

uint8_t gear_calculate_value() {
	uint16_t rpm_periode = timer_get_rpm_periode();
	if (rpm_periode != 0xffff && speed_periode != 0xffff) {
		return speed_periode / (rpm_periode >> 6);
	} else {
		return 0;
	}
}
