#include <stdint.h>
#include "lcd.h"

#include "font.h"

#if 1
// Präprozessor-Anweisung für Folding

// Pixeldaten der Zeichen, siehe gfx/font8x6.png, Erstellen mit convert-font8x6.py
static const uint8_t FONT_DATA[] = { 0x0, 0x0, 0x0, 0x0, 0x0, 0x0, 0x0, 0x6f,
		0x0, 0x0, 0x0, 0x7, 0x0, 0x7, 0x0, 0x14, 0x7f, 0x14, 0x7f, 0x14, 0x1c,
		0x22, 0x6b, 0x2a, 0x10, 0x23, 0x13, 0x8, 0x64, 0x62, 0x36, 0x49, 0x56,
		0x20, 0x50, 0x0, 0x0, 0x7, 0x0, 0x0, 0x0, 0x1c, 0x22, 0x41, 0x0, 0x0,
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		0x38, 0x45, 0x44, 0x25, 0x7c };
#endif

/**
 * Zeichnen eines Zeichens in 7x5 Schriftart
 *
 * @param x			X-Position
 * @param y_page	Y-Page
 * @param c			Zeichen
 */
void font_draw_char(uint8_t x, uint8_t y_page, char c) {
	const uint8_t *pt = &(FONT_DATA[5 * (c - 32)]);

	for (uint8_t i = 0; i < 5; i++) {
		lcd_set_pixels(x + i, y_page, *pt);
		pt++;
	}

	lcd_set_pixels(x + 5, y_page, 0);
}

/**
 * Zeichnen eines Zeichens in dicker 7x5 Schriftart
 *
 * @param x			X-Position
 * @param y_page	Y-Page
 * @param c			Zeichen
 */
void font_draw_char_bold(uint8_t x, uint8_t y_page, char c) {
	const uint8_t *pt = &(FONT_DATA[5 * (c - 32)]);
	uint8_t last = 0;

	for (uint8_t i = 0; i < 6; i++) {
		uint8_t current = (i == 5) ? 0 : *pt;
		lcd_set_pixels(x + i, y_page, current | last);
		last = current;
		pt++;
	}

	lcd_set_pixels(x + 6, y_page, 0);
}

/**
 * Zeichnen eines Zeichens in 7x5 Schriftart. Dieses Zeichen kann invertiert werden
 *
 * @param x			X-Position
 * @param y_page	Y-Page
 * @param c			Zeichen
 * @param mask		Maske zur Invertierung
 */
void font_draw_char_inverted(uint8_t x, uint8_t y_page, char c, uint8_t mask) {
	const uint8_t *pt = &(FONT_DATA[5 * (c - 32)]);

	for (uint8_t i = 0; i < 5; i++) {
		lcd_set_pixels(x + i, y_page, *pt ^ mask);
		pt++;
	}

	lcd_set_pixels(x + 5, y_page, mask);
}

/**
 * Zeichnen einer Zeichenkette
 *
 * @param x			X-Position
 * @param y_page	Y-Page
 * @param str		Zeichenkette, Ende der Zeichenkette mit '\0'
 */
void font_draw_string(uint8_t x, uint8_t y_page, const char *str) {
	while (*str != 0x0) {
		font_draw_char(x, y_page, *str);
		x += 6;
		str++;
	}
}

/**
 * Zeichnen einer Zeichenkette in dicker Schrift
 *
 * @param x			X-Position
 * @param y_page	Y-Page
 * @param str		Zeichenkette, Ende der Zeichenkette mit '\0'
 */
void font_draw_string_bold(uint8_t x, uint8_t y_page, const char *str) {
	while (*str != 0x0) {
		font_draw_char_bold(x, y_page, *str);
		x += 7;
		str++;
	}
}

/**
 * Zeichnen einer Zeichenkette. Diese kann invertiert werden.
 *
 * @param x			X-Position
 * @param y_page	Y-Page
 * @param str		Zeichenkette
 * @param invert	Gibt, an ob invertiert werden soll
 */
void font_draw_string_invert(uint8_t x, uint8_t y_page, const char *str,
		uint8_t invert) {
	uint8_t mask = invert ? 0xff : 0;
	while (*str != 0x0) {
		font_draw_char_inverted(x, y_page, *str, mask);
		x += 6;
		str++;
	}
}

/**
 * Anzeigen einer maximal 5-stelligen Ganzzahl
 *
 * @param x			X-Position
 * @param y_page	Y-Page
 * @param number	Zahl, die angezeigt werden soll
 * @param digit_count	Anzahl der Stellen der Zahl, führende Nullen werden entfernt, Zahl ist entsprechend wird rechtsbündig ausgegeben
 */
void font_draw_number(uint8_t x, uint8_t y_page, uint32_t number,
		uint8_t digit_count) {
	font_draw_number_invert(x, y_page, number, digit_count, 0, 0);
}

/**
 * Anzeigen einer maximal 5-stelligen Ganzzahl. Invertierung und führenden Nullen können eingestellt werden.
 *
 * @param x				X-Position
 * @param y_page		Y-Page
 * @param number		Zahl, die angezeigt werdne sollen
 * @param digit_count	Anzahl der Stellen der Zahl
 * @param invert		Gibt, an ob invertiert werden soll
 * @param leading_zeroes	Gibt, an ob die Zahl mit führenden Nullen angezeigt werden soll
 */
void font_draw_number_invert(uint8_t x, uint8_t y_page, uint32_t number,
		uint8_t digit_count, uint8_t invert, uint8_t leading_zeroes) {
	char string[6]; // Festlegung: Maximal 5 Stellen + \0

	// Zeichenkette erstellen
	for (uint8_t digit = 0; digit < digit_count; digit++) {
		char c = '0' + (number % 10);
		string[digit_count - digit - 1] = c;
		number /= 10;
	}

	// Führende Nullen entfernen
	if (!leading_zeroes) {
		for (uint8_t digit = 0; digit < digit_count - 1; digit++) {
			if (string[digit] == '0') {
				string[digit] = ' ';
			} else {
				break;
			}
		}
	}

	// \0 setzen
	string[digit_count] = 0;

	// Anzeigen
	font_draw_string_invert(x, y_page, string, invert);
}
